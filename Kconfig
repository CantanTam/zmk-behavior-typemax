## drivers/sensor/xw12a/Kconfig
```kconfig
config XW12A
    bool "XW12A capacitive touch sensor"
    default y
    depends on DT_HAS_XINWANG_XW12A_ENABLED
    select I2C
```

## dts/bindings/behaviors/sensor/xinwang,xw12a.yaml
```yaml
description: XW12A capacitive touch controller

compatible: "xinwang,xw12a"

include: i2c-device.yaml

properties:
  int-gpios:
    type: phandle-array
    required: true
    description: Interrupt GPIO pin for touch events
```

## dts/bindings/behaviors/zmk,behavior-blink.yaml
```yaml
# Copyright (c) 2020 The ZMK Contributors
# SPDX-License-Identifier: MIT

description: red or green led blink

compatible: "zmk,behavior-blink"

# 同样使用 two_param，因为你需要 &blink <索引> <次数>
include: two_param.yaml 

properties:
  gpios:
    type: phandle-array
    required: true
  label:
    type: string
```

## dts/bindings/behaviors/zmk,behavior-led.yaml
```yaml
# Copyright (c) 2020 The ZMK Contributors
# SPDX-License-Identifier: MIT

description: red or green led light

compatible: "zmk,behavior-led"

# 包含这个文件后，你就不需要手动写 "#binding-cells" 了
include: two_param.yaml 

properties:
  # 官方模板里没有这个，所以你必须手动加上，否则 DTS 里的 gpios 属性会报错
  gpios:
    type: phandle-array
    required: true
  label:
    type: string
```

## dts/bindings/behaviors/zmk,behavior-reclayer.yaml
```yaml
# Copyright (c) 2020 The ZMK Contributors
# SPDX-License-Identifier: MIT

description: "Record layer index to Flash"

compatible: "zmk,behavior-reclayer"

# 包含 one_param.yaml，它会自动处理 "#binding-cells = <1>"
include: one_param.yaml

# 如果你的行为不需要额外的硬件属性（如 gpios），properties 这里可以留空
# 或者直接删除整个 properties 块
properties:
  label:
    type: string
```

## dts/bindings/behaviors/zmk,behavior-togtouch.yaml
```yaml
# Copyright (c) 2020 The ZMK Contributors
# SPDX-License-Identifier: MIT

description: "Toggle touchtype function"

compatible: "zmk,behavior-togtouch"

include: zero_param.yaml

properties:
  label:
    type: string
```
